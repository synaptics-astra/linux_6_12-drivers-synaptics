## drm/Kconfig
```kconfig
# SPDX-License-Identifier: GPL-2.0

menu "Synaptics DRM drivers"

source "drivers/synaptics/drm/tiny/Kconfig"

endmenu
```

## drm/tiny/Kconfig
```kconfig
# SPDX-License-Identifier: GPL-2.0-only

config TINYDRM_ST7789V
	tristate "DRM support for Sitronix ST7789V display panels"
	depends on DRM && SPI
	select DRM_KMS_HELPER
	select DRM_GEM_DMA_HELPER
	select DRM_MIPI_DBI
	select BACKLIGHT_CLASS_DEVICE
	help
	  DRM driver for Sitronix ST7789 with one of the following
	  If M is selected the module will be called st7789v.
```

## iio/Kconfig
```kconfig
menuconfig SYNAPTICS_IIO
  bool "Synaptics IIO driver support"
  default n
  help
    Synaptics IIO driver support


if SYNAPTICS_IIO
if IIO

source "drivers/synaptics/iio/adc/Kconfig"

endif # IIO
endif
```

## iio/adc/Kconfig
```kconfig
menu "Analog to digital converters"

config SL261X_ADC
       tristate "Synaptics SL261X ADC"
       help
         Say yes here to build support for Synaptics SL261X ADC

endmenu
```

## net/can/Kconfig
```kconfig
# SPDX-License-Identifier: GPL-2.0-only
#
# PHY Layer Configuration
#

if CAN_DEV

config CAN_ARASAN
	tristate "Arasan CANFD"
	depends on COMMON_CLK && HAS_IOMEM
	help
	  Arasan CANFD driver. This driver supports Arasan CANFD IP.

endif #CAN_DEV
```
